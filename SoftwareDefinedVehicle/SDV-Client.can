/*@!Encoding:1252*/
includes
{
  
}

variables
{
  
}



on key 'a'
{
  
  // publish the MQTT topic with a value
  
  $sdvApp::clientApp.vissRequest.impl = "{ ignition: Set Request, type: attribute, description: set value of gateway starter signal, unit: , path: #/powertrain/engine/ignition/engineWheel, requestId: #/100000}";
  
}

on sysvar sysvar::VISSvars::ReadGearUpBtn
{
  
  // publish the MQTT topic with a value
  if(@this == 1){
  $sdvApp::clientApp.gearPositionUpRequest.impl = "{ gear: Set Request, type: attribute, description: set value of gear down, unit: int, path: #/powertrain/transmission/gearBox/gearDown, requestId: #/123000}";
  sysSetVariableString(sysvarString::VSSvars::JSON_String, $sdvApp::clientApp.gearPositionUpRequest.impl);
  }
}

on sysvar sysvar::VISSvars::ReadGearDownBtn
{
  
  // publish the MQTT topic with a value
  if(@this == 1){
    
  $sdvApp::clientApp.gearPositionDownRequest.impl = "{ gear: Set Request, type: attribute, description: set value of gear up, unit: int, path: #/powertrain/transmission/gearBox/gearUp, requestId: #/120000}";
  sysSetVariableString(sysvarString::VSSvars::JSON_String, $sdvApp::clientApp.gearPositionDownRequest.impl);
  }
}

on sysvar sysvar::VISSvars::ReadIgnitionBtn
{
      
  if (@this == 1)     // prevent double-triggering with panel button controls
  {
      $sdvApp::clientApp.ignitionRequest.impl = "{ ignition: Set Request, type: attribute, description: set value of gateway starter signal, unit: , path: #/powertrain/engine/ignition/engineWheel, requestId: #/100000}";
      sysSetVariableString(sysvarString::VSSvars::JSON_String, $sdvApp::clientApp.ignitionRequest.impl);
  }
}




on sysvar sysvar::VISSvars::ReadRadioOnOffBtn
{
      
  if (@this == 1)     // prevent double-triggering with panel button controls
  {
    // call the method to read the fault code from the TPMS server
    $sdvApp::clientApp.radioRequest.impl = "{ radio: Set Request, type: attribute, description: set value radio on/off, unit: bool, path: #/comfort/cabin/dashboard/infotainment/console/radioOnOff, requestId: #/124000}";
    sysSetVariableString(sysvarString::VSSvars::JSON_String, $sdvApp::clientApp.radioRequest.impl);
  }
}


on sysvar sysvar::VISSvars::ReadIndactorRightBtn
{
      
  if (@this == 1)     // prevent double-triggering with panel button controls
  {
    // call the method to read the fault code from the TPMS server
  
    $sdvApp::clientApp.indicatorRightRequest.impl = "{ indicatorRight: Set Request, type: attribute, description: set value indicator right, unit: int, path: #/comfort/cabin/dashbaord/infotainment/console/indicatorRight, requestId: #/125000}";
    sysSetVariableString(sysvarString::VSSvars::JSON_String, $sdvApp::clientApp.indicatorRightRequest.impl);
  }
}


on sysvar sysvar::VISSvars::ReadHeadLightsBtn
{
      
  if (@this == 1)     // prevent double-triggering with panel button controls
  {
    // call the method to read the fault code from the TPMS server
  
    $sdvApp::clientApp.headLightRequest.impl = "{ headLights: Set Request, type: attribute, description: set value headLight, unit: int, path: #/comfort/cabin/dashbaord/infotainment/console/headLight, requestId: #/125600}";
    sysSetVariableString(sysvarString::VSSvars::JSON_String, $sdvApp::clientApp.headLightRequest.impl);
  }
}

on sysvar sysvar::VISSvars::ReadIndicatorLeftBtn
{
      
  if (@this == 1)     // prevent double-triggering with panel button controls
  {
    // call the method to read the fault code from the TPMS server
  
    $sdvApp::clientApp.indicatorLeftRequest.impl = "{ indicatorLeft: Set Request, type: attribute, description: set value indicator left, unit: int, path: #/comfort/cabin/dashbaord/infotainment/console/indicatorLeft, requestId: #/126000}";
    sysSetVariableString(sysvarString::VSSvars::JSON_String, $sdvApp::clientApp.indicatorLeftRequest.impl);}
}

on sysvar sysvar::VISSvars::ReadSwitchHazardBtn
{
      
  if (@this == 1)     // prevent double-triggering with panel button controls
  {
    // call the method to read the fault code from the TPMS server
  
    $sdvApp::clientApp.hazardRequest.impl = "{ hazardLights: Set Request, type: attribute, description: set value indicator right, unit: int, path: #/comfort/cabin/dashbaord/infotainment/console/hazard, requestId: #/125000}";
    sysSetVariableString(sysvarString::VSSvars::JSON_String, $sdvApp::clientApp.hazardRequest.impl);}
}

on sysvar sysvar::VISSvars::ReadBrakeActiveBtn
{
      
  if (@this == 1)     // prevent double-triggering with panel button controls
  {
    // call the method to read the fault code from the TPMS server
  
    $sdvApp::clientApp.brakeRequest.impl = "{ brake: Set Request, type: attribute, description: set value brake, unit: int, path: #/powertrain/engine/brake/brakeOn, requestId: #/125800}"; 
    sysSetVariableString(sysvarString::VSSvars::JSON_String, $sdvApp::clientApp.brakeRequest.impl);}
}





on sysvar sysvar::VISSvars::ReadPedalPositionBtn
{
      
  if (@this == 1)     // prevent double-triggering with panel button controls
  {
    // call the method to read the fault code from the TPMS server
  
    $sdvApp::clientApp.pedalRequest.impl = "{ pedal: Set Request, type: attribute, description: set value pedal, unit: int, path: #/powertrain/engine/accelerator/pedal, requestId: #/123300}";  }
}